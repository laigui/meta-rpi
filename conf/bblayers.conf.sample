## conf/bblayers.conf.sample
```bitbake
# POKY_BBLAYERS_CONF_VERSION is increased each time build/conf/bblayers.conf
# changes incompatibly
POKY_BBLAYERS_CONF_VERSION = "2"

BBPATH = "${TOPDIR}"
BBFILES ?= ""

BBLAYERS ?= " \
    ${HOME}/yocto/poky-rocko/meta \
    ${HOME}/yocto/poky-rocko/meta-poky \
    ${HOME}/yocto/poky-rocko/meta-openembedded/meta-oe \
    ${HOME}/yocto/poky-rocko/meta-openembedded/meta-multimedia \
    ${HOME}/yocto/poky-rocko/meta-openembedded/meta-networking \
    ${HOME}/yocto/poky-rocko/meta-openembedded/meta-perl \
    ${HOME}/yocto/poky-rocko/meta-openembedded/meta-python \
    ${HOME}/yocto/poky-rocko/meta-qt5 \
    ${HOME}/yocto/poky-rocko/meta-raspberrypi \
    ${HOME}/yocto/poky-rocko/meta-security \
    ${HOME}/rpi/meta-rpi \
"
```
